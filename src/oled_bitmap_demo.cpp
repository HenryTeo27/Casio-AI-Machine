#include <Arduino.h>
#include <Wire.h>
#include <U8g2lib.h>
#include <vector>
#include "mbedtls/base64.h"

#define OLED_SDA 1
#define OLED_SCL 2
#define OLED_RST 47
#define SCREEN_W 128
#define SCREEN_H 32
#define BTN_SCROLL_UP 14
#define BTN_SCROLL_DOWN 21
#define BTN_SCROLL_LEFT 40
#define BTN_SCROLL_RIGHT 41

static constexpr uint32_t BUTTON_DEBOUNCE_MS = 35;
static constexpr int H_SCROLL_STEP = 32;
static constexpr uint32_t OLED_CLEAR_SETTLE_MS = 8;

U8G2_SSD1305_128X32_NONAME_F_HW_I2C u8g2(U8G2_R0, OLED_RST);

struct Button {
  uint8_t pin;
  bool lastStable = HIGH;
  bool lastRead = HIGH;
  unsigned long lastChange = 0;

  void begin(uint8_t p) {
    pin = p;
    pinMode(pin, INPUT_PULLUP);
    lastStable = digitalRead(pin);
    lastRead = lastStable;
    lastChange = millis();
  }

  bool fell() {
    bool reading = digitalRead(pin);
    if (reading != lastRead) {
      lastChange = millis();
      lastRead = reading;
    }
    if ((millis() - lastChange) >= BUTTON_DEBOUNCE_MS && reading != lastStable) {
      lastStable = reading;
      return lastStable == LOW;
    }
    return false;
  }
};

struct Block {
  int width;
  int height;
  const char* b64;
  std::vector<uint8_t> bytes;
  bool valid;
};

Button btnUp;
Button btnDown;
Button btnLeft;
Button btnRight;

int currentBlock = 0;
int currentX = 0;
int validCount = 0;

// Complex math answer sample copied from test/casio_oled_math_answer_display_blocks.json.
// The server-side convention for this file is already: 1 = OLED pixel ON,
// 0 = background OFF, so do not invert bytes before drawXBMP().
static Block kBlocks[] = {
  {
    128, 32,
    "AAAAAAAAAAAAAAAAAAAAAAAAAAAAAAAAAAAAAAAAAAAAAAAAAAAAAAAAAAAAAAAAAAAAAAAAAAAAAAAAAAAAAAAAAAAAAAAAAAAAAAAAAAAAAAAAAAAAAAAAAAAAAAAAAAAAAAAAAAAAAAAAAAAAAAAAAAAAAAAAAAAAAAAAAAAAAAAAAAAAAAAAAAAAAAAAAAAAAAAAAAAAAAAAAAAAAAAAAAAAAAAAAAAAAAAAAAAAAAAAAAAAAAAAAAAAAAAAAAAAAAAAAAAAAAAAAAAAAAgCAAAAAAAAAAAAAAAAAAAMAQAA/D8AAAAAAAAAAAAAfD8MPEQEAAAAAAAAAAAAAJIEDiZ8PwAAAAAAAAAAAACSCAgDRCEAAAAAAAAAAAAA/B8IAXwlAAAAAAAAAAAAAIAQCB0AJQAAAAAAAAAAAAD4Hwgj/iUAAAAAAAAAAAAAhAAIYRAlAAAAAAAAAAAAAIQACGEUJQAAAAAAAAAAAAD8PwhjdAwAAAAAAAAAAAAA4DAIIhQSAAAAAAAAAAAAAJgQPxyaIQAAAAAAAAAAAACOHAAAGgAAAAAAAAAAAAAAgAAAAOI/AAAAAAAAAAAAAAAAAAAAAAAAAAAAAAAAAAAAAAAAAAAAAAAAAAAAAAAAAAAAAAAAAAAAAAAAAAAAAAAAAAAAAAAAAAAAAAAAAAA="
  },
  {
    128, 32,
    "AAAAAAAAAAAAAAAAAAAAAAAAAAAAAAAAAAAAAAAAAAAAAAAAAAAAAAAAAAAAAAAAAAAAAAAAAAAAAAAAAAAAAAAAAAAAAAAAAAAAAAAAAAAAAAAAAAAAAAAAAAAAAAAAAACCAAAAACAGIAAAAAAAAIQHguAPAACQBkAA/wAAAACIBIJA/gEAkAb+D4EAAAAAgISHQA4BAMg/CACBAAAAAEAE8scXQQ9IBggBgQAAAABuGJJElsAITAYQAf8AAAAAKACSRJbACAwG/g8AAAAAAOgfl8S3wAgIBgLA5wMAAABIiPNHZsAI6D8CQCQCAAAAiAySRGbACAgGAkAkAgAAAIgFksRnwAgIBgJAJAIAAAAYA5JktsAICAYBQCQCAAAAzA/yB54BAAgGAcDnAwAAAGSYEQQOAAAIBgFAJAIAAAAAAAAAAAAAAAAAAAAAAAAAAAAAAAAAAAAAAAAAAAAAAEAAAAAhAAEAAAAAAAAAAABCAP4hJSABEAIAAAAAAAAARAACQRMgATADAAAAAAAAAOgfAuH3AQEgAQAAAAAAAAAgEQKBkfl/YAEAAAAAAAAAMBn+QZ8AYcAAAAAAAAAAABAJACCpgGDAAAAAAAAAAAAAgc+HoIAiwAAAAAAAAAAAiIJI5OeAJCABAAAAAAAAAISCSERiQCwgAQAAAAAAAAA="
  },
  {
    128, 32,
    "AAAAAAAAAAAAAAAAAAAAAAAAAAAAAAAAAAAAAAAAAAAAAAAAAAAAAAAAAAAAAAAAAAAAAAAAAAAAAAAAAAAAAAAAAAAAAAAAAAAAAAAAAAAAAAAAAAAAAAAAAAAAAAAAAAAQAAQAAEAAEAAAAAAAAP4fEiAE4B9AABKAweEQAAACEBJABCAQ/h8SwGEiEQAAQhAQgP4hEEAAEAAhJgkAAEKQ/wcSIRA0if8HISQJAAD6FxAGk+EfqAQQBiEkZQAAwhAIBpEAAEABCAYhJJUAAMIQKAIQ+HwsDSgCIcSSAABiEUiCKIhE8hJIAiEEkgAAMhPEQiiIREAAxAIhBpEAABoWBCJsiET+HwQCYQKRAAACEAICRohEQAAC4seBYAAA/h8BAoP5fEAAAQIAAAAAAAKQwIMAiURAgMADAAAAAAAAAAAAAAAAAAAAAAAAAAAAAAAAAAAAAAAAAAAAAAAAAAAAAAAAAAAAAAAAAAAAAAB+HgECAAAAAAAAAAAAAAAAgAEJAgAAAAAAAAAAAAAAAP4BEQMAAAAAAAAAAAAAAADCASEBAAAAAAAAAAAAAAAAwj8hAQAAAAAAAAAAAAAAAMIIAQEAAAAAAAAAAAAAAAD+CIEBAAAAAAAAAAAAAAAAggiJAAAAAAAAAAAAAAAAAIIIzwEAAAAAAAAAAAAAAAA="
  },
  {
    128, 32,
    "AAAAAAAAAAAAAAAAAAAAAAAAAAAAAAAAAAAAAAAAAAAAAAAAAAAAAAAAAAAAAAAAAAAAAAAAAAAAAAAAAAAAAAAAAAAAAAAAAAAAAAAAAAAAAAAAAAAAAAAAAAAAAAAAAAAAAAAAAAAAAAAAAAAAAAAAAAAAAAAAAAAAAAAAAAAAAAAAAAAAAAAAAAAAAAAAAAAAAAAAAAAAAAAAAAAAAAAAAAAAAAAAAAAAAAAAAAAAAAAAAAAAAAAAAAAAAAAAAAAAAAAAAAAAAAAAAAAAAEIAgB8EAAAAAAEAAAAAAABmAIAxAgDAAQwBAAAAAAAAJACAIQIAYAIOAgAAAAAAACwAgCGiByAECAIAAAAAAAAYcIIxYwQgBAgCAAAAAAAAGFCCH2EEIAQIAgAAAAAAABiAgSFhBCAECAIAAAAAAAAkAIBhYQQgBAgCAAAAAAAAJACAYWEEIAQIAgAAAAAAAEIAgCFixGAyCAIAAAAAAADDAIAfYsTAMT8CAAAAAAAAAAAAAAKAAAAAAgAAAAAAAAAAAAAEwAAAAAEAAAAAAAAAAAAABAAAAAABAAAAAAAAAAAAAAAAAAAAAAAAAAAAAAAAAAAAAAAAAAAAAAAAAAAAAAAAAAAAAAAAAAAAAAAAAAAAAAAAAAAAAAAAAAAAAAAAAAAAAAAAAAAAAAAAAAA="
  },
  {
    128, 32,
    "AAAAAAAAAAAAAAAAAAAAAAAAAAAAAAAAAAAAAAAAAAAAAAAAAAAAAAAAAAAAAAAAAAAAAAAAAAAAAAAAAAAAAAAAAAAAAAAAAAAAAAAAAAAAAAAAAAAAAAAAAAAAAAAAAAAAAAAAAAAAAAAAAAAAAAAAAAAAAAAAAAAAAAAAAAAAAAAAAAAAAAAAAAAAAAAAAAAAAAAAAAAAAAAAAAAAAAAAAAAAAAAAAAAAAAAAAAAAAAAAAAAAAAAAAAAAAAAAAAAAAAAAAAAAAAAAAAAAAAAAMAAAAAsAAAAAAAAAAAC+H//j/wETAAAAAAAAAAAAIgKEABIAI8AAAAAAAAAAAD6f/8f/+H/AAAAAAAAAAACiEABAkgADAAAAAAAAAAAAvhT+Q5IQIwAAAAAAAAAAAP4UAsP/IBMAAAAAAAAAAACIEv4DAmAfAAAAAAAAAAAAjBIC4/8BDwAAAAAAAAAAAHQC/gMhQAsAAAAAAAAAAAAMCRCAMHATwAAAAAAAAAAAzhAlgh8YY8AAAAAAAAAAABqAhQR+AEMAAAAAAAAAAADin/zggcEBAAAAAAAAAAAAAAAAAAAAAAAAAAAAAAAAAAAAAAAAAAAAAAAAAAAAAAAAAAAAAAAAAAAAAAAAAAAAAAAAAAAAAAAAAAAAAAAAAAAAAAAAAAAAAAAAAAAAAAA="
  },
  {
    128, 32,
    "AAAAAAAAAAAAAAAAAAAAAAAAAAAAAAAAAAAAAAAAAAAAAAAAAAAAAAAAAAAAAAAAAAAAAAAAAAAAAAAAAAAAAAAAAAAAAAAAAAAAAAAAAAAAAAAAAAAAAAAAAAAAAAAAAAAAAAAAAAAAAAAAAAAAAAAAAAAAAAAAAAAAAAAAAAAAAAAAAAAAAAAAAAAAAAAAAAAAAAAAAAAAAAAAAAAAAAAAAAAAAAAAAAAAAAAAAAAAAAAAAAAAAAAAAAAAAAAAAAAAAAAAAAAAAAAAAAAAAH6QEAAAABAAAAAAAAAAAADGiBkAgOEQAAAABzgAAAAAhggJAMAxIQAAgAlEAAAAAIYICwwAESIwAIAQhAAAAACGDAY4ABEi4PCDEIQAAAAAxgQGwAARIgADgBDEAAAAAH4EBuAAESKAA4AQuAAAAAAGBAkYABEiYPCDEIAAAAAABgQJBAARIhAAgBDAAAAAAAaIEAAAMSEAAICJRQAAAAAGyDAA4OcgAAAAhz0AAAAAAAgAAAAAIAAAAAAAAAAAAAAQAAAAABAAAAAAAAAAAAAAEAAAAAAQAAAAAAAAAAAAAAAAAAAAAAAAAAAAAAAAAAAAAAAAAAAAAAAAAAAAAAAAAAAAAAAAAAAAAAAAAAAAAAAAAAAAAAAAAAAAAAAAAAAAAAAAAAAAAAAAAAAAAAA="
  },
  {
    128, 32,
    "AAAAAAAAAAAAAAAAAAAAAAAAAAAAAAAAAAAAAAAAAAAAAAAAAAAAAAAAAAAAAAAAAAAAAAAAAAAAAAAAAAAAAAAAAAAAAAAAAAAAAAAAAAAAAAAAAAAAAAAAAAAAAAAAAAAAAAAAAAAAAAAAAAAAAAAAAAAAAAAAAAAAAAAAAAAAAAAAAAAAAAAAAAAAAAAAAAAAAAAAAAAAAAAAAAAAAAAAAAAAAAAAAAAAAAAAAAAAAAAAAAAAAAAAAAAAAAAAAAAAAAAAAAAAAAAAAAAAAHwfAAAAAAAAAAAAAAAAAABEETAAAAAAAAAAAAAAAAAARBEwAAAAAAAAAAAAAAAAAHwRAAAAAAAAAAAAAAAAAABEEQAAAAAAAAAAAAAAAAAARBEAAAAAAAAAAAAAAAAAAHwRAAAAAAAAAAAAAAAAAAAEEQAAAAAAAAAAAAAAAAAAJBEAAAAAAAAAAAAAAAAAADQdMAAAAAAAAAAAAAAAAABeATAAAAAAAAAAAAAAAAAAQgEAAAAAAAAAAAAAAAAAAAABAAAAAAAAAAAAAAAAAAAAAAAAAAAAAAAAAAAAAAAAAAAAAAAAAAAAAAAAAAAAAAAAAAAAAAAAAAAAAAAAAAAAAAAAAAAAAAAAAAAAAAAAAAAAAAAAAAAAAAAAAAAAAAAAAAAAAAAAAAAAAAAAAAA="
  },
  {
    128, 32,
    "AAAAAAAAAAAAAAAAAAAAAAAAAAAAAAAAAAAAAAAAAAAAAAAAAAAAAAAAAAAAAAAAAAAAAAAAAAAAAAAAAAAAAAAAAAAAAAAAAAAAAAAAAAAAAAAAAAAAAAAAAAAAAAAAAADwg4QAAAAAgAAAAAAAABgAMEbMAAAABocAAAAAAAAcADBESAAAAIcJAQAAAAAAEAAwRFgABgCEEAEAAAAAABAAMGQwgPEDhBABAAAAAAAQADAmMGAAAIQQAQAAAAAAEADwIzBgAACEEAEAAAAAABBwMCBIgPMDhBABAAAAAAAQADAgSAAEAIQQAQAAAAAAEAAwQIQAAACECQEAAAAAAH4AMECGAQCAHwcBAAAAAAAAAABAAAAAAAAAAQAAAAAAAAAAgAAAAAAAgAAAAAAAAAAAAIAAAAAAAIAAAAAAAAAAAAAAAAAAAAAAAAAAAAAAAAAAAAAAAAAAAAAAAAAAAAAAAAAAAAAAAAAAAAAAAAAAAOAABwAAAAAAAAAAAAAAAAAwgQgAAAAAAAAAAAAAAAAAEIMYAAAAAAAAAAAAAAAGABCCEAAAAAAAAAAAAAAAHH4QghAAAAAAAAAAAAAAAGAAEIIYAAAAAAAAAAAAAABwABACFwAAAAAAAAAAAAAADH4QAhAAAAAAAAAAAAAAAAIAEAMYAAAAAAAAAAAAAAA="
  },
  {
    128, 32,
    "AAAAAAAAAAAAAAAAAAAAAAAAAAAAAAAAAAAAAAAAAAAAAAAAAAAAAAAAAAAAAAAAAAAAAAAAAAAAAAAAAAAAAAAAAAAAAAAAAAAAAAAAAAAAAAAAAAAAAAAAAAAAAAAAAAAAAAAAAAAAAAAAAAAAAAAAAAAAAAAAAAAAAAAAAAAAAAAAAAAAAAAAAAAAAAAAAAAAAAAAAAAAAAAAAAAAAAAAAAAAAAAAAAAAAAAAAAAAAAAAAAAAAAAAAAAAAAAAAAAAAAAAAAAAAAAAAAAAAH6QEAAAAAAQAAAAAAAAAADGiBkAAMDgEAAAAAcwAAAAhggJAADgMCEAAIAJOAAAAIYIC8AAgBAiAAOAECAAAACGDAYw/IAQIsDwgxAgAAAAxgQGDACAECIwAIAQIAAAAH4EBgwAgBAiMACAECAAAAAGBAlw/IAQIsDxgxAgAAAABgQJgACAECIAAoAQIAAAAAaIEAAAgDAhAACAySAAAAAGyDAAAPDjIAAAAMf8AAAAAAgAAAAAACAAAAAAAAAAAAAQAAAAAAAQAAAAAAAAAAAAEAAAAAAAEAAAAAAAAAAAAAAAAAAAAAAAAAAAAAAAAAAAAAAAAAAAAAAAAAAAAAAAAAAAAAAAAAAAAAAAAAAAAAAAAAAAAAAAAAAAAAAAAAAAAAAAAAAAAAAAAAAAAAA="
  },
  {
    128, 32,
    "AAAAAAAAAAAAAAAAAAAAAAAAAAAAAAAAAAAAAAAAAAAAAAAAAAAAAAAAAAAAAAAAAAAAAAAAAAAAAAAAAAAAAAAAAAAAAAAAAAAAAAAAAAAAAAAAAAAAAAAAAAAAAAAAAAAAAAAAAAAAAAAAAAAAAAAAAAAAAAAAAAAAAAAAAAAAAAAAAAAAAAAAAAAAAAAAAAAAAAAAAAAAAAAAAAAAAAAAAAAAAAAAAAAAAAAAAAAAAAAAAAAAAAAAAAAAAAAAAAAAAAAAAAAAAAAAAAAAAAgEMAAAAAAAAAAAAAAAAAAIBDAAAAAAAAAAAAAAAAAA/h8wAAwAAAAAAAAAAAAAAAiE/wcMAAAAAAAAAAAAAAD4hzAEAAAAAAAAAAAAAAAACIQwBAAAAAAAAAAAAAAAAAiEMAQAAAAAAAAAAAAAAAD4hzAEAAAAAAAAAAAAAAAACIT/BwAAAAAAAAAAAAAAAAiEMAQAAAAAAAAAAAAAAAD+HzAADAAAAAAAAAAAAAAAAAAwAAwAAAAAAAAAAAAAABwOMAAAAAAAAAAAAAAAAAAGEDAAAAAAAAAAAAAAAAAAAAAAAAAAAAAAAAAAAAAAAAAAAAAAAAAAAAAAAAAAAAAAAAAAAAAAAAAAAAAAAAAAAAAAAAAAAAAAAAAAAAAAAAAAAAAAAAAAAAAAAAAAAAA="
  },
  {
    128, 32,
    "AAAAAAAAAAAAAAAAAAAAAAAAAAAAAAAAAAAAAAAAAAAAAAAAAAAAAAAAAAAAAAAAAAAAAAAAAAAAAAAAAAAAAAAAAAAAAAAAAAAAAAAAAAAAAAAAAAAAAAAAAAAAAAAAAAAAAAAAAAAAAAAAAAAAAAAAAAAAAAAAAAAAAAAAAAAAAAAAAAAAAAAAAAAAAAAAAAAAAAAAAAAAAAAAAAAAAAAAAAAAAAAAAAAAAAAAAAAAAAAAAAAAAAAAAAAAAAAAAAAAAAAAAAAAAAAAAAAAAH6QEAAAAAAQAAAAAAAAAADGiBkAAMDgEAAAAAAAAAAAhggJAADgMCEAAAAAAAAAAIYIC8AAgBAiAAAAAAAAAACGDAYw/IAQIgAAAAAAAAAAxgQGDACAECIAAAAAAAAAAH4EBgwAgBAiAAAAAAAAAAAGBAlw/IAQIgAAAAAAAAAABgQJgACAECIAAAAAAAAAAAaIEAAAgDAhAAAAAAAAAAAGyDAAAPDjIAAAAAAAAAAAAAgAAAAAACAAAAAAAAAAAAAQAAAAAAAQAAAAAAAAAAAAEAAAAAAAEAAAAAAAAAAAAAAAAAAAAAAAAAAAAAAAAAAAAAAAAAAAAAAAAAAAAAAAAAAAAAAAAAAAAAAAAAAAAAAAAAAAAAAAAAAAAAAAAAAAAAAAAAAAAAAAAAAAAAA="
  },
  {
    128, 32,
    "AAAAAAAAAAAAAAAAAAAAAAAAAAAAAAAAAAAAAAAAAAAAAAAAAAAAAAAAAAAAAAAAAAAAAAAAAAAAAAAAAAAAAAAAAAAAAAAAAAAAAAAAAAAAAAAAAAAAAAAAAAAAAAAAAACAAQAAAAAAAAAAAAAAAADwgwEAAAAAAAAAAAAAAAAAMIABAAcAhgMAAAAAAAAAACCAAYAJAMcEAAAAAAAAAABAgBmAEABECAAAAAAAAAB+gICJnxAARAgAAAAAAAAAAICABYAQAEQIAAAAAAAAAADAgAeAEABECAAAAAAAAAB+QICHnxAARAgAAAAAAAAAACCACYAQAEQIAAAAAAAAAAAwgBmAiRnEBAAAAAAAAAAA8IcRAIeZnwMAAAAAAAAAAAAAAAAAAAAAAAAAAAAAAAAAAAAAAAAAAAAAAAAAAAAAAAAAAAAAAAAAAAAAAAAAAAAAAAAAAAAAAAAAAAAAAAAAABgAAAAAADAAAAAAAAB4EAAYCAQAAAEwAAAAAAAAjAgAGAjiAAzBMAAAAAAAAAYIABgQMgEOwjAAAAAAAAACiB6YERICCKIxAwAAAAAAAowRmBATAggiMQEAAAAAAAKEEVgQEQIIMrEAAAAAAAAChBF4EBECCBLyAAAAAAAAAoQReBARAggC8AAAAAAAAAaEEZgQEQIIAjABAAAAAAA="
  },
  {
    128, 32,
    "AAAAAAAAAAAAAAAAAAAAAAAAAAAAAAAAAAAAAAAAAAAAAAAAAAAAAAAAAAAAAAAAAAAAAAAAAAAAAAAAAAAAAAAAAAAAAAAAAAAAAAAAAAAAAAAAAAAAAAAAAAAAAAAAAAAAAAAAAAAAAAAAAAAAAAAAAAAAAAAAAAAAAAAAAAAAAAAAAAAAAAAAAAAAAAAAAAAAAAAAAAAAAAAAAAAAAAAAAAAAAAAAAAAAAAAAAAAAAAAAAAAAAAAAAAAAAAAAAAAAAAAAAAAAAAAAAAAAAAAAAAAAAAAAADAAAAAAAAAAAIAAACAAEAAwEAAAAAAAAABAOIAjMAgAMBAAAAAAAAACQUxARDAIADAgAAAAAAAAhkGEQEhoiB4wIwAAAAAAAMxghEBISIwRMCEAAAAAAAB4IIRATEyEEbAgAAAAAAAAMCCEgEuEhBHwIAAAAAAAAHgghABIAISR8yAAAAAAAADMIIQATACEETAhAAAAAAAAhkFMTEQAiBEwIwAAAAAAAAJBOMxDAIgRMCIAAAAAAAAAQAAAQAAIAAAgAAAAAAAAAIAAACAAEAAAEAAAAAAAAACAAAAgABAAABAAAAAAAAAAAAAAAAAAAAAAAAAAAAAAAAAAAAAAAAAAAAAAAAAAAAAAAAAAAAAAAAAAAAAAAAAAAAAAAAAAAAAAAAAAAAA="
  },
  {
    128, 32,
    "AAAAAAAAAAAAAAAAAAAAAAAAAAAAAAAAAAAAAAAAAAAAAAAAAAAAAAAAAAAAAAAAAAAAAAAAAAAAAAAAAAAAAAAAAAAAAAAAAAAAAAAAAAAAAAAAAAAAAAAAAAAAAAAAAAAAAAAgBvwPMAAAAAAAAH4eAeL/IRQMCDAAAAAAAACAAQkCEiAk/A8wAAAAAAAA/gERw/94RAwIMAAAAAAAAMIBIUGSID/8DzIBPQAAAADCPyFBkiAEAAAzAiMAAAAAwggBwf8gJP4fMQIjAAAAAP4IgQEC8CREADEGIwAAAACCCIng/zkU/J8xBCMAAAAAggjPASEgGESJMAQjAAAAAIKIY4IwIAx8jTAMIwAAAADCCDCGHyBORAYwACMAAAAAQggMBH4gU34PMAAAAAAAAAAIAOCBGWDAEBwAAAAAAAAAAAAAAAAAAAAAAAAAAAAAEAEAAAAAAAAAAAAAAAAAAAgBAAAAAAAAAAAAAAAAAAD4HzAAAAAAAAAAAAAAAAAABAEwAAAAAAAAAAAAAAAAAOYfAAAAAAAAAAAAAAAAAAAmEQAAAAAAAAAAAAAAAAAAJBEAAAAAAAAAAAAAAAAAAOQfAAAAAAAAAAAAAAAAAAAkAQAAAAAAAAAAAAAAAAAAZAEAAAAAAAAAAAAAAAAAAMQBMAAAAAAAAAAAAAAAAAA="
  },
  {
    128, 32,
    "AAAAAAAAAAAAAAAAAAAAAAAAAAAAAAAAAAAAAAAAAAAAAAAAAAAAAAAAAAAAAAAAAAAAAAAAAAAAAAAAAAAAAAAAAAAAAAAAAAAAAAAAAAAAAAAAAAAAAAAAAAAAAAAAAGAAAAAAAAAAAAAAAAAAAH5gAAAAAAAAAAAAAAAAAAAGYADgAMBwAAAAAAAAAAAABGAAMAHgmAAAAAAAAAAAAAhgBhACgAgBAAAAAAAAAAAQYPITAoAIAQAAAAAAAAAAEGABEAKACAEAAAAAAAAAABjgARACgAgBAAAAAAAAAAAI4PETAoAIAQAAAAAAAAAABGACEAKACAEAAAAAAAAAAAZgBjAxg5gAAAAAAAAAAAD+YATgMPNzAAAAAAAAAAAAAAAAAAAAAAAAAAAAAAAAAAAAAAAAAAAAAAAAAAAAAAAAAAAAAAAAAAAAAAAAAAAAAAAAAAAAAAAAAAAAAAAAAAAAABgAAAAAADAAAAAAAAB4EAAYCAQAAAEwAAAAAAAAjAgAGAjiAAzBMAAAAAAAAAYIABgQMgEOwjAAAAAAAAACiB6YERICCKIxAwAAAAAAAowRmBATAggiMQEAAAAAAAKEEVgQEQIIMrEAAAAAAAAChBF4EBECCBLyAAAAAAAAAoQReBARAggC8AAAAAAAAAaEEZgQEQIIAjABAAAAAAA="
  },
  {
    128, 32,
    "AAAAAAAAAAAAAAAAAAAAAAAAAAAAAAAAAAAAAAAAAAAAAAAAAAAAAAAAAAAAAAAAAAAAAAAAAAAAAAAAAAAAAAAAAAAAAAAAAAAAAAAAAAAAAAAAAAAAAAAAAAAAAAAAAAAAAAAAAADAAAAAAAAAAAAAAgCAAEAAwEAAAAAAAAAAAOEAh8AgAMBAAAAAAAAACAQxgQjBIADAgAAAAAAAABgGEYIQoSE9wIwAAAAAAAAwgxGCECExI8CEAAAAAAAA4IEQghgxESPAggAAAAAAAMCAEAIXERIjwIMAAAAAAADggRACEAEQI86DAAAAAAAAMIMQAhgBECPAhAAAAAAAABgGMbEIASAjwIwAAAAAAAAIBOGwBwEgI8CIAAAAAAAAAAABAAABIAAAgAAAAAAAAAAAAgCAAEAAAEAAAAAAAAAAAAIAgABAAABAAAAAAAAAAAAAAAAAAAAAAAAAAAAAAAAAAAAAAAAAAAAAAAAAAAAAAOAABgAAAAAAAAAAAAAAAAAwAQcAAAAAAAAAAAAAAAAAEAMEAAAAAAAAAAAAAABgABACBAAAAAAAAAAAAAAAGH4QAgQAAAAAAAAAAAAAAAYAEAIEAAAAAAAAAAAAAAAGABACBAAAAAAAAAAAAAAAOH4QAgQAAAAAAAAAAAAAAEAAEAMEAAAAAAAAAAAAAAA="
  },
  {
    128, 32,
    "AAAAAAAAAAAAAAAAAAAAAAAAAAAAAAAAAAAAAAAAAAAAAAAAAAAAAAAAAAAAAAAAAAAAAAAAAAAAAAAAAAAAAAAAAAAAAAAAAAAAAAAAAAAAAAAAAAAAAAAAAAAAAAAAAAAAAAAAAAAAAAAAAAAAAAAAAAAAAAAAAAAAAAAAAAAAAAAAAAAAAAAAAAAAAAAAAAAAAAAAAAAAAAAAAAAAAAAAAAAAAAAAAAAAAAAAAAAAAAAAAAAAAAAAAAAAAAAAAAAAAAAAAAAAAAAAAAAAAAgAgUAQAAAAAAAAAAAAAADID4PA/wEAAAAAAAAAAAAABAiGIE0AAwAAAAAAAAAAAAQEgMD/AAMAAAAAAAAAAAASAoDAgAAAAAAAAAAAAAAAn437x/8AAAAAAAAAAAAAAOg4gsCAAAAAAAAAAAAAAAAEAILA/wAAAAAAAAAAAAAA3h+CwP8AAAAAAAAAAAAAAAYCggAhAAAAAAAAAAAAAAAAAorg/wEDAAAAAAAAAAAAHgKGACEAAwAAAAAAAAAAAOAfg8AgAAAAAAAAAAAAAAAAAIBgIAAAAAAAAAAAAAAAAAAAAAAAAAAAAAAAAAAAAAAAAAAAAAAAAAAAAAAAAAAAAAAAAAAAAAAAAAAAAAAAAAAAAAAAAAAAAAAAAAAAAAAAAAAAAAAAAAAAAAAAAAA="
  },
  {
    128, 32,
    "AAAAAAAAAAAAAAAAAAAAAAAAAAAAAAAAAAAAAAAAAAAAAAAAAAAAAAAAAAAAAAAAAAAAAAAAAAAAAAAAAAAAAAAAAAAAAAAAAAAAAAAAAAAAAAAAAAAAAAAAAAAAAAAAAAAAAAAAQAAAAAAAAAAAAAAAAAAA8EEAAAAAAAAAAAAAABh+GBBBAAAAAAAAAAAAAAAcBhwQ/wAAAAAAAAAAAHoAEAYQEEEAAAAAAAAAAABG/BACEBBBAAAAAAAAAAAARgAQPhDwRQAAAAAAAAAAAEYAEGAQEE0AAAAAAAAAAABG/BBAEBBJAAAAAAAAAAAARgAQQBAQQRgAAAAAAAAAAEYAEGIQ8EE4AAAAAAAAAABGAH48fhBAIAAAAAAAAAAAAAAAAAAQQBAAAAAAAAAAAAAAAAAAAHgIAAAAAAAAAAAAAAAAAAAAAAAAAAAAAAAAAAAAAAAAAAAAAAAAAAAAAH6QEAAAQAAAAAAAAAAAAADGiBkAg0MAOIADAAAAAAAAhggJgMOEAExABAAAAAAAAIYIiwFCiICFQAgAAAAAAACGDAYHQohghEAIAAAAAAAAxgQGGEKIGIRADAAAAAAAAH4EBhxCiBiEgAsAAAAAAAAGBAkDQojghAAIAAAAAAAABgSJAEKIAIUADAAAAAAAAAaIEADChABMTAQAAAAAAAA="
  },
  {
    128, 32,
    "AAAAAAAAAAAAAAAAAAAAAAAAAAAAAAAAAAAAAAAAAAAAAAAAAAAAAAAAAAAAAAAAAAAAAAAAAAAAAAAAAAAAAAAAAAAAAAAAAAAAAAAAAAAAAAAAAAAAAAAAAAAAAAAAAAAAAAAAQAAAAAAAAAAAAAAAAAAA8EEAAAAAAAAAAAAAABh+HBBBAAAAAAAAAAAAAAAcBiIQ/wAAAAAAAAAAAHoAEAZgEEEAAAAAAAAAAABG/BACYBBBAAAAAAAAAAAARgAQPiDwRQAAAAAAAAAAAEYAEGAwEE0AAAAAAAAAAABG/BBAGBBJAAAAAAAAAAAARgAQQAwQQRgAAAAAAAAAAEYAEGIG8EE4AAAAAAAAAABGAH48fhBAIAAAAAAAAAAAAAAAAAAQQBAAAAAAAAAAAAAAAAAAAHgIAAAAAAAAAAAAAAAAAAAAAAAAAAAAAAAAAAAAAAAAAAAAAAAAAAAAAH6QEAAAQAAAAAAAAAAAAADGiBkAg0MAABzg4ODBAAAAhggJgMOEAAAmEDER4QAAAIYIiwFCiOAhQhASAoMAAACGDAYHQogQE0IQEgKBAAAAxgQGGEKIEAxCEBPigAAAAH4EBhxCiMAAQuASAoEAAAAGBAkDQogwI0IAEgKCAAAABgSJAEKIEB5CABMCggAAAAaIEADChAAAJhMxGYMAAAA="
  },
  {
    128, 32,
    "AAAAAAAAAAAAAAAAAAAAAAAAAAAAAAAAAAAAAAAAAAAAAAAAAAAAAAAAAAAAAAAAAAAAAAAAAAAAAAAAAAAAAAAAAAAAAAAAAAAAAAAAAAAAAAAAAAAAAAAAAAAAAAAAAAAAAAAAAAAAAAAAAAAAAAAAAAAAAAAAAAAAAAAAAAAAAAAAAAAAAAAAAAAAAAAAAAAAAAAAAAAAAAAAAAAAAAAAAAAAAAAAAAAAAAAAAAAAAAAAAAAAAAAAAAAAAAAAAAAAAAAAAAAAAAAAAAAAAAAAAAAAAAAAAAAAAAAAAAAA4AAOAAAAAAAAAAAAAAAAADABEQAAAAAAAAAAAAAAAAAQAzEAAAAAAAAAAAAAAAAGEAIhAAAAAAAAAAAAAAAAHBACIQAAAAAAAAAAAAAAAGAQAjEAAAAAAAAAAAAAAABwEAIuAAAAAAAAAAAAAAAADBACIAAAAAAAAAAAAAAAAAIQAzAAAAAAAAAAAAAAAAAAMDERAAAAAAAAAAAAAAAAAOAwDwAAAAAAAAAAAAAAAAAAAAAAAAAAAAAAAAAAAAAAAAAAAAAAAAAAAAAAAAAAAAAAAAAAAAAAAAAAAAAAAAAAAAAAAAAAAAAAAAAAAAAAAAAAAAAAAAAAAAAAAAAAAAAAAAAAAAAAAAAAAAAAAAAAAAAAAAAAAAAAAAAAAAA="
  },
  {
    128, 32,
    "AAAAAAAAAAAAAAAAAAAAAAAAAAAAAAAAAAAAAAAAAAAAAAAAAAAAAAAAAAAAAAAAAAAAAAAAAAAAAAAAAAAAAAAAAAAAAAAAAAAAAAAAAAAAAAAAAAAAAAAAAAAAAAAAAAAAAAAAAAAAAAAAAAAAAAAAAAAAAAAAAAAAAAAAAAAAAAAAAAAAAAAAAAAAAAAAAAAAAAAAAAAAAAAAAAAAAAAAAAAAAAAAAAAAAAAAAAAAAAAAAAAAAAAAAAAAAAAAAAAAAAAAA4AAggAAAAAAAH4eAeL/AQOAAILgDwAAAACAAQkCAiAT/B+CQP4BAwAA/gERAyMgMwSAh0AOAQMAAMIBIQFBMCOEGPLHFwEAAADCPyHh/xBDlAiSRJYAAAAAwggBAQAJU5QIkkSWAAAAAP4IgQEECBM0CZfEtwAAAACCCInA/8ARJIXzR2YAAAAAggjPAQQACCQEkkRmAAAAAIKIYwIEAAwCApLEZwADAADCCDAGBAADAgKSZLYAAwAAQggM5P/hAfof8geeAQAAAAAIAAAAMAACgBEEDgAAAAAAAAAAAAAAAAAAAAAAAAAAAAAAAAAAAAAAAAAAAAAAAAAAAAAAAAAAAAAAAAAAAAAAAAAAAAAAAAAAAAAAAAAAAAAAAAAAAAAAAAAAAAAAAAAAAAAAAAAAAAAAAAAAAAA="
  },
  {
    128, 32,
    "AAAAAAAAAAAAAAAAAAAAAAAAAAAAAAAAAAAAAAAAAAAAAAAAAAAAAAAAAAAAAAAAAAAAAAAAAAAAAAAAAAAAAAAAAAAAAAAAAAAAAAAAAAAAAAAAAAAAAAAAAAAAAAAAAAAAAAAAAAAAAAAAAAAAAAAAAAAAAAAAAAAAAAAAAAAAAAAAAAAAAAAAAAAAAAAAAAAAAAAAAAAAAAAAAAAAAAAAAAAAAAAAAAAAAAAAAAAAAAAAAAAAAAAAAAAAAAAAAAAAAAAAAAAAAAAAAAAAAAAAAAAAAAAAACAGAAAAAAAGAAAAIAAAAACQBgAAAAAABgAAACAADD8OkAYAAAAAAAYAAAAgAA4DEcg/AAAAAAB+eEQ8PgYIAzBIBgAAAAAARsxsZiMGCAEwTAYAAAAAAMaEKUIhAAgfEAwGAAAAAACGhDl+IQAIMBgIBgAAAAAAhoQ5AiEACCAM6D8AAAAAAMaEKQIhAAggBggGAAAAAABGzGQGMwYIMQMIBgAAAAAAOnhEOC4GPx4/CAYAAAAAAAAAAAAAAAAAAAgGAAAAAAAAAAAAAAAAAAAIBgAAAAAAAAAAAAAAAAAAAAAAAAAAAAAAAAAAAAAAAAAAAAAAAAAAAAAAAAAAAAAAAAAAAAAAAAAAAAAAAAAAAAAAAAAAAAAAAAAAAAAAAAAAAAAAAAA="
  },
  {
    128, 32,
    "AAAAAAAAAAAAAAAAAAAAAAAAAAAAAAAAAAAAAAAAAAAAAAAAAAAAAAAAAAAAAAAAAAAAAAAAAAAAAAAAAAAAAAAAAAAAAAAAAAAAAAAAAAAAAAAAAAAAAAAAAAAAAAAAAAAAAAAAAAAAAAAAAAAAAAAAAAAAAAAAAAAAAAAAAAAAAAAAAAAAAAAAAAAAAAAAAAAAAAAAAAAAAAAAAAAAAAAAAAAAAAAAAAAAAAAAAAAAAAAAAAAAAAAAAAAAAAAAAAAAAAAAAAAAAAAAAAAAAAgCAAAAAAAAAAAAAAAAAAAMAQAA/D8AAAAAAAAAAAAAfD8eHkQEAAAAAAAAAAAAAJIEMTF8PwAAAAAAAAAAAACSCCAgRCEAAAAAAAAAAAAA/B8gIHwlAAAAAAAAAAAAAIAQMDAAJQAAAAAAAAAAAAD4HxAQ/iUAAAAAAAAAAAAAhAAYGBAlAAAAAAAAAAAAAIQADAwUJQAAAAAAAAAAAAD8PwQEdAwAAAAAAAAAAAAA4DADAxQSAAAAAAAAAAAAAJgQf3+aIQAAAAAAAAAAAACOHAAAGgAAAAAAAAAAAAAAgAAAAOI/AAAAAAAAAAAAAAAAAAAAAAAAAAAAAAAAAAAAAAAAAAAAAAAAAAAAAAAAAAAAAAAAAAAAAAAAAAAAAAAAAAAAAAAAAAAAAAAAAAA="
  },
  {
    128, 32,
    "AAAAAAAAAAAAAAAAAAAAAAAAAAAAAAAAAAAAAAAAAAAAAAAAAAAAAAAAAAAAAAAAAAAAAAAAAAAAAAAAAAAAAAAAAAAAAAAAAAAAAAAAAAAAAAAAAAAAAAAAAAAAAAAAAABAwAAAAAgCAAAhAAEAAISHUcD88T8IAhAgJSABQgCIBPvHiBAjCAIQQBMgAWYAgARI4FEQIz4eMOD3AQEkAEAEQMAwECMAAjCAkfl/LABuGPzH2PA/MgIwQJ8AYRgAKICjwYYRIxQCOCCpgGAYAOgfo8EhECOUH0iAoIAiGABICLPl/PA/lBBI4OeAJCQAiAybxSAQI5QQhEBiQCwkAIgFD8f+AQO8EIZhYkAgQgAYAwPAIAADhhADg/EgIMMAzI8NyCAAA4DfAc6eESAAAGSY+GcgAAOAEAAgCAk8AAAAAAAAAAAAAAAAAAAAAAAAAAAAAAAAAAAAAAAAAAAAAAAQAIAgAAEAAAAAAAAAAAB+kP+BICABGBwcIAQAAAAAQhLAgCAgARwmJmAGAAAAAFISYODjAQEQYmJAAgAAAABSEjAAIPh/EEJCwAIAAAAAUhIYICMAYRBCQoABAAAAAFISDEAhgGAQQkKAAQAAAABSEgZA+YEiEEJCgAEAAAAAUhIDQAmBJBBCQkcCAAAAAFISAUQJQSwQYmJAAgAAAAA="
  },
  {
    128, 32,
    "AAAAAAAAAAAAAAAAAAAAAAAAAAAAAAAAAAAAAAAAAAAAAAAAAAAAAAAAAAAAAAAAAAAAAAAAAAAAAAAAAAAAAAAAAAAAAAAAAAAAAAAAAAAQAAAAABAEAABCABAwAAAACAAwAATwf/4fS2AUMH8AAPgfeAAEKAoADMnD/jEiAAAEAMwADEgRAIzfABJ4FAAA/g+GAQwAAwAMUAQQMAwAAEoMAwMM8D/8jE8E/zE2AADIhDEMDgADhIzI52iwYQAAiAQwABL4f4SMSMBocAgAAP4fMAASAAiEjE/AbDk/AABoBDAAIfh//IzIw2YxCAAAhAQwgGEgCASMT8DDsX8AAPwfMMDAwAgAjEjIADAIAAAABDBwgIMIAIxIZAMyCAAAAAcwAAAADgCHzCf+GQgAAAAAAAAAAAAAAAAAAAAAAAAAAAAAAAAAAAAAAAAAAAAAAAAAAAIgCAAAAAAAAAAAAAAAMAACIAgAgJ9HgAAAAAAAAHjg/yEIAABgQIIAAwAAAADMAAH4eACAf0DEAAMAAAAAhoEJAAgAgHBASAAAAAAAAAODCMgIAIDwT0gAAAAA/p8xjAhQCACAMEJAAAAAAAAAMMD/UH4AgD9CYAAAAAAAADAACFBCAIAgQiIAAAAAAAAwAAhQQgyAIMJzAAAAAAAAMOD/8UIcgCDimAADAAA="
  },
  {
    128, 32,
    "AAAAAAAAAAAAAAAAAAAAAAAAAAAAAAAAAAAAAAAAAAAAAAAAAAAAAAAAAAAAAAAAAAAAAAAAAAAAAAAAAAAAAAAAAAAAAAAAAAAAAAAAAAAAAAAAAAAAAAAAAAAAAAAAAAAAAAAAAAAAAAAAAAAAAAAAAAAAAAAAAAAAAAAAAAAAAAAAAAAAAAAAAAAAAAAAAAAAAAAAAAAAAAAAAAAAAAAAAAAAAAAAAAAAAAAAAAAAAAAAAAAAAAAAAAAAAAAAAAAAAAAAAAAAAAAAAAAAAEIAgB8EAAAAAACAAAAAAABmAIAxgsHBAXCAnwAAAAAAJACAIcJhYgKYgAEBAAAAACwAgCECISQECIEBAQAAAAAYcIIxAyEkBAiBAAEAAAAAGFCCHwEhJAQIgQ8BAAAAABiAgSEBISQECAEYAQAAAAAkAIBhASEkBAgBEAEAAAAAJACAYQEhJAQIARABAAAAAEIAgCECYWIymJgYAQAAAADDAIAf4sfBMXAYDwEAAAAAAAAAAAIAACAAAAABAAAAAAAAAAAEAAAwAACAAAAAAAAAAAAABAAAAAAAgAAAAAAAAAAAAAAAAAAAAAAAAAAAAAAAAAAAAAAAAAAAAAAAAAAAAAAAAAAAAAAAAAAAAAAAAAAAAAAAAAAAAAAAAAAAAAAAAAAAAAAAAAAAAAAAAAA="
  },
  {
    128, 32,
    "AAAAAAAAAAAAAAAAAAAAAAAAAAAAAAAAAAAAAAAAAAAAAAAAAAAAAAAAAAAAAAAAAAAAAAAAAAAAAAAAAAAAAAAAAAAAAAAAAAAAAAAAAAAAAARAAIAAIAAAAAAAAAAAhAcCQP6BACAAAAAAAAAAAIgE/udR+H/+HwAAAAAAAACABAFAUEAAEAAAAAAAAAAAQIT/o/xhAhAAdA4AAAAAAG6YEqNUIQL4D8wZAAAAAAAoADKhVCECHAyMGAAAAAAA6B8i4VXxP/YPjBgAAAAAAEiI/4dUAQISDIwYAAAAAACIDBqBrAECEAyMGAAAAAAAiAUh4a35f/APjBgAAAAAABgD/4ckAQIQDIwYAAAAAADMDwCBBAECEAwAAAAAAAAAZBjAgYQBAhAHAAAAAAAAAAAAAAAAAAAAAAAAAAAAAAAAAAAAAAAAAAAAAAAAAAAAAAAAAAAAAAAAAAAAAAAAAAAAIAARAAAAAAAAAAAAAADAACCAEAAAAAAAAAAAAAAA4AH/hxAAAAAAAAAAAAAAADADAUD+AQAAAAAAAAAAAAAYBilBAAAAAAAAAAAAAAAADAwpYYQAAAAAAAAAAAAAAMYwLVOEAAAAAAAAAAAAAADAALdERAAAAAAAAAAAAAAAwIBhQEQAAAAAAAAAAAAAAMCA/ENIOAAAAAAAAAAAAAA="
  },
  {
    128, 32,
    "AAAAAAAAAAAAAAAAAAAAAAAAAAAAAAAAAAAAAAAAAAAAAAAAAAAAAAAAAAAAAAAAAAAAAAAAAAAAAAAAAAAAAAAAAAAAAAAAAAAAAAAAAAAAAAQAAAAAIAAAAwwAAAAA/h/+R/75eSAA/+D/AQAAACABCoQgAAb+HzAgAgEAAAD8DwsEIPgHEID/JwIBAAAAJAkJ5CAIBxAAMAB/AAAAACSJ+YckCP/4D7TAIQAAAAD8D0GA5AkjHIy3Qx4AAAAAIAD9hyT4I/YPtAAeAAAAAP4f4YAkCCISDLeE4wEAAAAQAmGBJAgiEIz8538BAAAACANRgyUIIvAP/IBAAAAAAPgBSYYkCCMQDLaBQAAAAADgB0VE/gkhEIwxhn8AAAAAHhhBAAAAIBAHMIBAAAAAAAAAAAAAAAAAAAAAAAAAAAAAAAAAAAAAAAAAAAAAAAAAAAAAAAAAAAAAAAAAAAAAACAAIAARAAD8DwAAAAAAAAAgACCAEAAAQID/BwAAAAAA/h//hxAAAP4fSAAMAAAAABAAAUD+AQBCEP8DDAAAAAAQAClBAAAAehdJAgAAAAAA+A8pYYQAAEAASQIAAAAAABwMLVOEAAB8D/8DAAAAAAD2D7dERAAA/h8IAAAAAAAAEoxhQEQAAECA/wcAAAAAABCM/ENIMAD8D4QAAAAAAAA="
  },
  {
    128, 32,
    "AAAAAAAAAAAAAAAAAAAAAAAAAAAAAAAAAAAAAAAAAAAAAAAAAAAAAAAAAAAAAAAAAAAAAAAAAAAAAAAAAAAAAAAAAAAAAAAAAAAAAAAAAAAAAAAAAAAAAAAAAAAAAAAAAAAAAAAAAAAAAAAAAAAAAAAAAAAAAAAAAAAAAAAAAAAAAAAAAAAAAAAAAAAAAAAAAAAAAAAAAAAAAAAAAAAAAAAAAAAAAAAAAAAAAAAAAAAAAAAAAAAAAAAAAAAAAAAAAAAAAAAAAAAAAAAAAAAAAAAAAAAAAAAAAAAAAAAAAABCAAAAAAAAAAAAAAAAAAAAZgAAAAAAAAAAAAAAAAAAACQAAAAAAAAAAAAAAAAAAAAsAAOAzgEAAAAAAAAAAAAAGMDwgzkDAAAAAAAAAAAAABgwAIARAwAAAAAAAAAAAAAYMACAEQMAAAAAAAAAAAAAJMDxgxEDAAAAAAAAAAAAACQAAoARAwAAAAAAAAAAAABCAACAEQMAAAAAAAAAAAAAwwAAgBEDAAAAAAAAAAAAAAAAAAAAAAAAAAAAAAAAAAAAAAAAAAAAAAAAAAAAAAAAAAAAAAAAAAAAAAAAAAAAAAAAAAAAAAAAAAAAAAAAAAAAAAAAAAAAAAAAAAAAAAAAAAAAAAAAAAAAAAAAAAAAAAAAAAAAAAAAAAAAAAAAAAA="
  },
  {
    128, 32,
    "AAAAAAAAAAAAAAAAAAAAAAAAAAAAAAAAAAAAAAAAAAAAAAAAAAAAAAAAAAAAAAAAAAAAAAAAAAAAAAAAAAAAAAAAAAAAAAAAAAAAAAAAAAAAAAAAAAAAAAAAAAAAAAAAAAAAAAAAAAAAAAAAAAAAAAAAAAAAAAAAAAAAAAAAAAAAAAAAAAAAAAAAAAAAAAAAAAAAAAAAAAAAAAAAAAAAAAAAAAAAAAAAAAAAAAAAAAAAAAAAAAAAAAAAAAAAAAAAAAAAAAAAAAAAAAAAAAAAAAAAAAAAAAAAAAAAAAAAAAD4BwAAAAAAAAAAAAAAAAAACAQAAAAAAAAAAAAAAAAAAAgEAAAAAAAAAAAAAAAAAAAIBAAAAAAAAAAAAAAAAAAA+AcAAAAAAAAAAAAAAAAAAAgEAAAAAAAAAAAAAAAAAAAIBAAAAAAAAAAAAAAAAAAA+AcAAAAAAAAAAAAAAAAAAAgEAAAAAAAAAAAAAAAAAAAIBAAAAAAAAAAAAAAAAAAACAQAAAAAAAAAAAAAAAAAAP4fAAAAAAAAAAAAAAAAAAAAAAAAAAAAAAAAAAAAAAAAAAAAAAAAAAAAAAAAAAAAAAAAAAAAAAAAAAAAAAAAAAAAAAAAAAAAAAAAAAAAAAAAAAAAAAAAAAAAAAAAAAAAAAAAAAAAAAAAAAAAAAAAAAA="
  },
  {
    128, 32,
    "AAAAAAAAAAAAAAAAAAAAAAAAAAAAAAAAAAAAAAAAAAAAAAAAAAAAAAAAAAAAAAAAAAAAAAAAAAAAAAAAAAAAAAAAAAAAAAAAAAAAAAAAAAAAAAAAAAAAAAAAAAAAAAAAAAAAAAAAAAAAAAAAAAAAAAAAAAAAAAAAAAAAAAAAAAAAAAAAAAAAAAAAAAAAAAAAAAAAAAAAAAAAAAAAAAAAAAAAAAAAAAAAAAAAAAAAAAAAAAAAAAAAAAAAAAAAAAAAAAAAAAAAAAAAAAAAAAAAAAAAAAAAAAAAAAAAAAAAAAAAAAAgBAAAAAAAAAAAAAAAGBwcYAYAAAAAAAAAAAAAABwmJkACAAAAAAAAAAAAAAAQQkLAAjAA6BwAAAAAAAAAEEJCgAEMP5gzAAAAAAAAABBCQoABAwAYMQAAAAAAAAAQQkKAAQMAGDEAAAAAAAAAEEJCRwIcPxgxAAAAAAAAABBCQkACIAAYMQAAAAAAAAAQJiYgBAAAGDEAAAAAAAAAfhwcMAwAABgxAAAAAAAAAAAAAAAAAAAAAAAAAAAAAAAAAAAAAAAAAAAAAAAAAAAAAAAAAAAAAAAAAAAAAAAAAAAAAAAAAAAAAAAAAAAAAAAAAAAAAAAAAAAAAAAAAAAAAAAAAAAAAAAAAAAAAAAAAAAAAAAAAAAAAAAAAAAAAAA="
  },
  {
    128, 32,
    "AAAAAAAAAAAAAAAAAAAAAAAAAAAAAAAAAAAAAAAAAAAAAAAAAAAAAAAAAAAAAAAAAAAAAAAAAAAAAAAAAAAAAAAAAAAAAAAAAAAAAAAAAAAAAAAAAAAAAAAAAAAAAAAAAAAAAAAAAAAAAAAAAAAAAAAAAAAAAAAAAAAAAAAAAAAAAAAAAAAAAAAAAAAAAAAAAAAAAAAAAAAAAAAAAAAAAAAAAAAAAAAAAAAAAAAAAAAAAAAAAAAAAAAAAAAAAAAAAAAAAAAAAAAAAAAAAAAAAHwfAAAAAAAAAAAAAAAAAABEETAAAAAAAAAAAAAAAAAARBEwAAAAAAAAAAAAAAAAAHwRAAAAAAAAAAAAAAAAAABEEQAAAAAAAAAAAAAAAAAARBEAAAAAAAAAAAAAAAAAAHwRAAAAAAAAAAAAAAAAAAAEEQAAAAAAAAAAAAAAAAAAJBEAAAAAAAAAAAAAAAAAADQdMAAAAAAAAAAAAAAAAABeATAAAAAAAAAAAAAAAAAAQgEAAAAAAAAAAAAAAAAAAAABAAAAAAAAAAAAAAAAAAAAAAAAAAAAAAAAAAAAAAAAAAAAAAAAAAAAAAAAAAAAAAAAAAAAAAAAAAAAAAAAAAAAAAAAAAAAAAAAAAAAAAAAAAAAAAAAAAAAAAAAAAAAAAAAAAAAAAAAAAAAAAAAAAA="
  },
  {
    128, 32,
    "AAAAAAAAAAAAAAAAAAAAAAAAAAAAAAAAAAAAAAAAAAAAAAAAAAAAAAAAAAAAAAAAAAAAAAAAAAAAAAAAAAAAAAAAAAAAAAAAAAAAAAAAAAAAAAAAAAAAAAAAAAAAAAAAAAAAAAAAAAAAAAAAAAAAAAAAAAAAAAAAAAAAAAAAAAAAAAAAAAAAAAAAAAAAAAAAAAAAAAAAAAAAAAAAAAAAAAAAAAAAAAAAAAAAAAAAAAAAAAAAAAAAAAAAAAAAAAAAAAAAAAAAAAAAAAAAAAAAAAAAAAAAAAAAAAAAAAAAAAAAAAAAAAAAACEAAAAAAAAAGBwcAAAAAAAzAAAAAAAAABwmJgAAAAAAEgAAAAAAAAAQQkKgcwAGABaAAUDnAAAAEEJCYM6A4QcMYPjBnAEAABBCQmDEYAAADBgAwIgBAAAQQkJgxGAAAAwYAMCIAQAAEEJCZ8SA4wcS4PjBiAEAABBCQmDEAAQAEgABwIgBAAAQJiZgxAAAACEAAMCIAQAAfhwcYMQAAIBhAADAiAEAAAAAAAAAAAAAAAAAAAAAAAAAAAAAAAAAAAAAAAAAAAAAAAAAAAAAAAAAAAAAAAAAAAAAAAAAAAAAAAAAAAAAAAAAAAAAAAAAAAAAAAAAAAAAAAAAAAAAAAAAAAAAAAAAAAAAAAAAAAAAAAAAAAAAAAA="
  },
  {
    128, 32,
    "AAAAAAAAAAAAAAAAAAAAAAAAAAAAAAAAAAAAAAAAAAAAAAAAAAAAAAAAAAAAAAAAAAAAAAAAAAAAAAAAAAAAAAAAAAAAAAAAAAAAAAAAAAAAAAAAAAAAAAAAAAAAAAAAAAAAAAAAAAAAAAAAAAAAAAAAAAAAAAAAAAAAAAAAAAAAAAAAAAAAAAAAAAAAAAAAAAAAAAAAAAAAAAAAAAAAAAAAAAAAAAAAAAAAAAAAAAAAAAAAAAAAAAAAAAAAAAAAAAAAAAAAAAAAAAAAAAAAAAAAMAAAAAsAAAAAAAAAAAC+H//j/wETAAAAAAAAAAAAIgKEABIAI8AAAAAAAAAAAD6f/8f/+H/AAAAAAAAAAACiEABAkgADAAAAAAAAAAAAvhT+Q5IQIwAAAAAAAAAAAP4UAsP/IBMAAAAAAAAAAACIEv4DAmAfAAAAAAAAAAAAjBIC4/8BDwAAAAAAAAAAAHQC/gMhQAsAAAAAAAAAAAAMCRCAMHATwAAAAAAAAAAAzhAlgh8YY8AAAAAAAAAAABqAhQR+AEMAAAAAAAAAAADin/zggcEBAAAAAAAAAAAAAAAAAAAAAAAAAAAAAAAAAAAAAAAAAAAAAAAAAAAAAAAAAAAAAAAAAAAAAAAAAAAAAAAAAAAAAAAAAAAAAAAAAAAAAAAAAAAAAAAAAAAAAAA="
  },
  {
    128, 32,
    "AAAAAAAAAAAAAAAAAAAAAAAAAAAAAAAAAAAAAAAAAAAAAAAAAAAAAAAAAAAAAAAAAAAAAAAAAAAAAAAAAAAAAAAAAAAAAAAAAAAAAAAAAAAAAAAAAAAAAAAAAAAAAAAAfhAAAAAAAAAAQAgAAAAAAcYIhoMDAAAAAMAMAAAAAAGGCMfEBAAAAACABAAAAAAChghESAjoHIABgAVgAOgcAoYMREgImDNg+AEDGD+YMwLGBERICBgxGAAAAwYAGDECfgRESAgYMRgAAAMGABgxAgYEREjIGTHg+IEEOD8YMQIGBERICBgxAAGABEAAGDECBgjExAQYMQAAQAgAABgxAgaIn4MDGDEAAGAYAAAYMQIACAAAAAAAAAAAAAAAAAACABAAAAAAAAAAAAAAAAAAAQAQAAAAAAAAAAAAAAAAAAEAAAAAAAAAAAAAAAAAAAAAAAAAAAAAAAAAAAAAAAAAAAAAAAAAAAAAAAAAAAAAAAAAAOAAhx8AAAAAAAAAAAAAAAAwgYgBAAAAAAAAAAAAAAAAEIOYAQAAAAAAAAAAAAAGABCCkAAAAAAAAAAAAAAAHH4QgpAPAAAAAAAAAAAAAGAAEIIYGAAAAAAAAAAAAABwABACFxAAAAAAAAAAAAAADH4QAhAQAAAAAAAAAAAAAAIAEAMYEAAAAAAAAAAAAAA="
  },
  {
    128, 32,
    "AAAAAAAAAAAAAAAAAAAAAAAAAAAAAAAAAAAAAAAAAAAAAAAAAAAAAAAAAAAAAAAAAAAAAAAAAAAAAAAAAAAAAAAAAAAAAAAAAAAAAAAAAAAAAAAAAAAAAAAAAAAAAAAAAAAAAAAAAAAAAAAAAAAAAAAAAAAAAAAAAAAAAAAAAAAAAAAAAAAAAAAAAAAAAAAAAAAAAAAAAAAAAAAAAAAAAAAAAAAAAAAAAAAAAAAAAAAAAAAAAAAAAAAAAAAAAAAAAAAAAAAAAAAAAAAAAAAAAHwfAAAAAAAAAAAAAAAAAABEETAAAAAAAAAAAAAAAAAARBEwAAAAAAAAAAAAAAAAAHwRAAAAAAAAAAAAAAAAAABEEQAAAAAAAAAAAAAAAAAARBEAAAAAAAAAAAAAAAAAAHwRAAAAAAAAAAAAAAAAAAAEEQAAAAAAAAAAAAAAAAAAJBEAAAAAAAAAAAAAAAAAADQdMAAAAAAAAAAAAAAAAABeATAAAAAAAAAAAAAAAAAAQgEAAAAAAAAAAAAAAAAAAAABAAAAAAAAAAAAAAAAAAAAAAAAAAAAAAAAAAAAAAAAAAAAAAAAAAAAAAAAAAAAAAAAAAAAAAAAAAAAAAAAAAAAAAAAAAAAAAAAAAAAAAAAAAAAAAAAAAAAAAAAAAAAAAAAAAAAAAAAAAAAAAAAAAA="
  },
  {
    128, 32,
    "AAAAAAAAAAAAAAAAAAAAAAAAAAAAAAAAAAAAAAAAAAAAAAAAAAAAAAAAAAAAAAAAAAAAAAAAAAAAAAAAAAAAAAAAAAAAAAAAAAAAAAAAAAAAAAAAAAAAAAAAAAAAAAAAAGAAAAAAAAAAAAAAAAAAAH5gAAAAAAAAAAAAAAAAAAAGYADA4OAAAAAAAAAAAAAABGAA4DAxAQAAAAAAAAAAAAhgBoAQEgKdA6BzAAAAAAAQYPKDEBICcwZgzgAAAAAAEGABgBASAiMGYMQAAAAAABjgAYAQEgIjBmDEAAAAAAAI4PGDEBI6IwZgxAAAAAAABGACgBASAiMGYMQAAAAAAAZgBoAwMQEjZmbEAAAAAAD+YATw4+AAI2ZmxAAAAAAAAAAAAAAAAAAAAAAAAAAAAAAAAAAAAAAAAAAAAAAAAAAAAAAAAAAAAAAAAAAAAAAAAAAAAAAAAAAAAAAAAAAAAAAAAAAADAAAAAAAAAAAAAB4EAAAAAwEAQBAAAAAAAAAjAiGgwMMhHCAX2BgcHAAAAYIx8QEDIiYgIFgcJiYAAACCERICMyICIGB0EAICQEAAgxESAhMyAiBgJBACAkBAAIEREgILEgIgY+YQAgJAQACBERICDxICAGYCEEICQEAAgRESAg8SAgBkABACAkBAAYEREgITEgIAZAAQAgJAQA="
  },
  {
    128, 32,
    "AAAAAAAAAAAAAAAAAAAAAAAAAAAAAAAAAAAAAAAAAAAAAAAAAAAAAAAAAAAAAAAAAAAAAAAAAAAAAAAAAAAAAAAAAAAAAAAAAAAAAAAAAAAAAAAAAAAAAAAAAAAAAAAAAAAAAAAAAAAAAAAAAAAAAAAAAAAAAAAAAAAAAAAAAAAAAAAAAAAAAAAAAAAAAAAAAAAAAAAAAAAAAAAAAAAAAAAAAAAAAAAAAAAAAAAAAAAAAAAAAAAAAAAAAAAAAAAAAAAAAAAAAAAAAAAAAAAAAAAAAAAAAAAAAAAAAAAAAAAAAOAAhx8AAAAAAAAAAAAAAAAwgYgBAAAAAAAAAAAAAAAAEIOYAQAAAAAAAAAAAAAGABCCkAAAAAAAAAAAAAAAHH4QgpAPAAAAAAAAAAAAAGAAEIIYGAAAAAAAAAAAAABwABACFxAAAAAAAAAAAAAADH4QAhAQAAAAAAAAAAAAAAIAEAMYEAAAAAAAAAAAAAAAADCZyAgAAAAAAAAAAAAAAADgmAcHAAAAAAAAAAAAAAAAAAAAAAAAAAAAAAAAAAAAAAAAAAAAAAAAAAAAAAAAAAAAAAAAAAAAAAAAAAAAAAAAAAAAAAAAAAAAAAAAAAAAAAAAAAAAAAAAAAAAAAAAAAAAAAAAAAAAAAAAAAAAAAAAAAAAAAAAAAAAAAAAAAA="
  },
  {
    128, 32,
    "AAAAAAAAAAAAAAAAAAAAAAAAAAAAAAAAAAAAAAAAAAAAAAAAAAAAAAAAAAAAAAAAAAAAAAAAAAAAAAAAAAAAAAAAAAAAAAAAAAAAAAAAAAAAAAAAAAAAAAAAAAAAAAAAAAAAAAAAAAAAAAAAAAAAAAAAAAAAAAAAAAAAAAAAAAAAAAAAAAAAAAAAAAAAAAAAAAAAAAAAAAAAAAAAAAAAAAAAAAAAAAAAAAAAAAAAAAAAAAAAAAAAAAAAAAAAAAAAAAAAAAAAAAAAAAAAAAAAAAAAAECgEAQAAAAAAAAAAAD2HzDAIPF/AAAAAAAAAAAAjAF4gCBJE8AAAAAAAAAAAMAZzAD+8T/AAAAAAAAAAAAwDYYBQDAgAAAAAAAAAAAAgAYD40DwPwAAAAAAAAAAAEaGMYxAMCAAAAAAAAAAAAAkCzCAXvA/AAAAAAAAAAAAhBIwgEjwPwAAAAAAAAAAAEQCMIBIQAgAAAAAAAAAAAA0AjCASPh/wAAAAAAAAAAAjAMwgFlBCMAAAAAAAAAAAB4AMMCGMQgAAAAAAAAAAADiHzBAgBkIAAAAAAAAAAAAAAAAAAAAAAAAAAAAAAAAAAAAAAAAAAAAAAAAAAAAAAAAAAAAAAAAAAAAAAAAAAAAAAAAAAAAAAAAAAAAAAAAAAAAAAAAAAAAAAAAAAAAAAA="
  },
  {
    128, 32,
    "AAAAAAAAAAAAAAAAAAAAAAAAAAAAAAAAAAAAAAAAAAAAAAAAAAAAAAAAAAAAAAAAAAAAAAAAAAAAAAAAAAAAAAAAAAAAAAAAAAAAAAAAAAAAAAAAAAAAAAAAAAAAAAAAAAAAAAAAAAAAAAAAAAAAAAAAAAAAAAAAAAAAAAAAAAAAAAAAAAAAAAAAAAAAAAAAAAAAAAAAAAAAAAAAAAAAAAAAAAAAAAAAAAAAAAAAAAAAAAAAAAAAAAAAAAAAAAAAAAAAAAAAAAAAAAAAAAAAAAAAAAAAAAQAAAAAAAAAAAAAAAAAAB8EAAAAAAAAAAAAAADAjwMRBAAAAAAAAAAAAAAAwEAE8Q8AAAAAAAAAAAA6B8BACBEEAAAAAAAAAAAA5sxPQAgRBAAAAAAAAAAAAEYMwEcMXwQAAAAAAAAAAABGDACMC9EEAAAAAAAAAAAARswPCAiRBAAAAAAAAAAAAEYMAAgMEYQBAAAAAAAAAABGDEBMBB+EAwAAAAAAAAAARgyAxwMBBAIAAAAAAAAAAAAAAAAAAQQBAAAAAAAAAAAAAAAAAICHAAAAAAAAAAAAAAAAAAAAAAAAAAAAAAAAAAAAAAAAAAAAAAAAAAAAAAAAAAAAAAAAAAAAAAAAAAAAAAAAAAAAAAAAAAAAAAAAAAAAAAAAAAAAAAAAAAAAAAA="
  },
  {
    128, 32,
    "AAAAAAAAAAAAAAAAAAAAAAAAAAAAAAAAAAAAAAAAAAAAAAAAAAAAAAAAAAAAAAAAAAAAAAAAAAAAAAAAAAAAAAAAAAAAAAAAAAAAAAAAAAAAAAAAAAAAAAAAAAAAAAAAfhAAAABACAAAACAAAAAAAMYIDAMAwAwA4MchAAAAAACGCIwDAIAEAGAgQgAAAAAAhggKAgyABQxgIEQAAAAAAIYMCQLDDwPjJyBEAAAAAADGhAnCAADDAOAjRgAAAAAAfoQIwgAAwwAAxkUAAAAAAAbEHwLHjwTnBwREAAAAAAAGBAgCCIAECAAERgAAAAAABggIAgBACAAgJkIAAAAAAAYIyA8AYBgAwONBAAAAAAAACAAAAAAAAAAAQAAAAAAAABAAAAAAAAAAACAAAAAAAAAQAAAAAAAAAAAgAAAAAAAAAAAAAAAAAAAAAAAAAAAAAAAAAAAAAAAAAAAAAAAAAAAAAAAAAAAAAAAAAAAAAAAAAAdwYHgwABzA4QcAAAAAAIAJiGBEOAAmIGIAAAAAAACAGIhRwCAAYiBmAAAAAAB4iBAIWcAgwEIgJAAAAAAAxIQQCElAIDBCIOQDAAAAAASDEIhFOCAMQiAGBgAAAAAwgBBwRUAgDELABQQAAAAAzIgQAP+AIHBCAAQEAAAAAISHGIBBgCCAYgAGBAAAAAA="
  },
  {
    128, 32,
    "AAAAAAAAAAAAAAAAAAAAAAAAAAAAAAAAAAAAAAAAAAAAAAAAAAAAAAAAAAAAAAAAAAAAAAAAAAAAAAAAAAAAAAAAAAAAAAAAAAAAAAAAAAAAAAAAAAAAAAAAAAAAAAAAAAAAAAAAAAAAAAAAAAAAAAAAAAAAAAAAAAAAAAAAAAAAAAAAAAAAAAAAAAAAAAAAAAAAAAAAAAAAAAAAAAAAAAAAAAAAAAAAAAAAAAAAAAAAAAAAAAAAAAAAAAAAAAAAAAAAAAAAAAAAAAAAAAAAAAAAAAAAAAQAAAAAAAAAAAAAAAAAAB8EAAAAAAAAAAAAAAAAhwMRBAAAAAAAAAAAAAAAgMgE8Q8AAAAAAAAAAAA6B0BACBEEAAAAAAAAAAAA5sxPQAgRBAAAAAAAAAAAAEYMQEcIXwQAAAAAAAAAAABGDMBMCNEEAAAAAAAAAAAARsxPSAiRBAAAAAAAAAAAAEYMQEgIEYQBAAAAAAAAAABGDMDMBB+EAwAAAAAAAAAARgyAhwMBBAIAAAAAAAAAAAAAAAAAAQQBAAAAAAAAAAAAAAAAAICHAAAAAAAAAAAAAAAAAAAAAAAAAAAAAAAAAAAAAAAAAAAAAAAAAAAAAAAAAAAAAAAAAAAAAAAAAAAAAAAAAAAAAAAAAAAAAAAAAAAAAAAAAAAAAAAAAAAAAAA="
  },
  {
    128, 32,
    "AAAAAAAAAAAAAAAAAAAAAAAAAAAAAAAAAAAAAAAAAAAAAAAAAAAAAAAAAAAAAAAAAAAAAAAAAAAAAAAAAAAAAAAAAAAAAAAAAAAAAAAAAAAAAAAAAAAAAAAAAAAAAAAAfhAAAABACAAAACAAAAAAAMYIjAMAwAwAgMMhAAAAAACGCMwEAIAEAEBkQgAAAAAAhghKCAyABQwgIEQAAAAAAIYMSQjDDwPjJyBEAAAAAADGhEnIAADDAKAjRAAAAAAAfoRIyAAAwwBgJkQAAAAAAAbEXwjHjwTnJyREAAAAAAAGBEgICIAECCAkRAAAAAAABgjIBABACABgZkIAAAAAAAYIiAMAYBgAwMNBAAAAAAAACAAAAAAAAAAAQAAAAAAAABAAAAAAAAAAACAAAAAAAAAQAAAAAAAAAAAgAAAAAAAAAAAAAAAAAAAAAAAAAAAAAAAAAAAAAAAAAAAAAAAAAAAAAAAAAAAAAAAAAAAAAAAAAAdwcGB4ABzA4QcAAAAAAIAJiIhgzAAmIGIAAAAAAACAGIgFUIQAYiBmAAAAAAB4iBAIBViEDEIgJAAAAAAAxIQQCHVISDhCIOQDAAAAAASDEIjNRDjAQiAGBgAAAAAwgBBwhUTE4ELABQQAAAAAzIgQAIX+hBhCAAQEAAAAAISHGICFQIQEYgAGBAAAAAA="
  },
  {
    128, 32,
    "AAAAAAAAAAAAAAAAAAAAAAAAAAAAAAAAAAAAAAAAAAAAAAAAAAAAAAAAAAAAAAAAAAAAAAAAAAAAAAAAAAAAAAAAAAAAAAAAAAAAAAAAAAAAAAAAAAAAAAAAAAAAAAAAAAAAAAAAAAAAAAAAAAAAAAAAAAAAAAAAAAAAAAAAAAAAAAAAAAAAAAAAAAAAAAAAAAAAAAAAAAAAAAAAAAAAAAAAAAAAAAAAAAAAAAAAAAAAAAAAAAAAAAAAAAAAAAAAAAAAAAGAAAAAMAAAAAAAAH4eAYIAgAD+HzDg/xEeAACAAQmC//l/IAAyARIgEsAA/gERQwBAADACMsP/ABLAAMIBIeH/YAIQBDNCkgARAADCPyGhxCAC/g8xRJK4YQAAwggBgUwgAgCQMMX/oAAAAP4IgYFI8D9AgDABAqB/AACCCIng/wEC/A8c4f8hIQAAggjPgUYAAkAAgAAhIDIAAIKIY0JI+H9AAMCAMCAWwADCCDDG/wECQAAwgB9gDMAAQggMBEAAAv4fHgB+MD8AAAAIAABwAAIAAAPggZFhAAAAAAAAAAAAAAAAAAAAAAAAAAAAAAAAAAAAAAAAAAAAAAAAAAAAAAAAAAAAAAAAAAAAAAAAAAAAAAAAAAAAAAAAAAAAAAAAAAAAAAAAAAAAAAAAAAAAAAAAAAAAAAAAAAA="
  },
  {
    128, 32,
    "AAAAAAAAAAAAAAAAAAAAAAAAAAAAAAAAAAAAAAAAAAAAAAAAAAAAAAAAAAAAAAAAAAAAAAAAAAAAAAAAAAAAAAAAAAAAAAAAAAAAAAAAAAAAAAAAAAAAAAAAAAAAAAAAAAAAAAAAAAAAAAAAAAAAAAAAAAAAAAAAAAAAAAAAAAAAAAAAAAAAAAAAAAAAAAAAAAAAAAAAAAAAAAAAAAAAAAAAAAAAAAAAAAAAAAAAAAAAAAAAAAAAAAAAAAAAAAAAAAAAAAAAAAAAAAAAAAAAAAAAAAAAAAAAAACAAEQAAAAGAAAAIAAAAAADgABCAAAABgAAACAAHA6AB/wfQgAAAAYAAAAgACITwAwEAPkHAAB+eEQ8PgYBIWAYpAQBAAAARsxsZiMGASEwMKSEEQIAAMaEKUIhAB0hGMO0TBECAACGhDl+IQAzIQAD3BIRAQAAhoQ5AiEAISEAA4YBEQEAAMaEKQIhACEhAAPyDyEBAABGzGQGMwYzEwADggAhAQAAOnhEOC4GHg4AA4IAgQAAAAAAAAAAAAAAAAOCAP0PAAAAAAAAAAAAAAAD+x8BAAAAAAAAAAAAAAAAAAAAAAAAAAAAAAAAAAAAAAAAAAAAAAAAAAAAAAAAAAAAAAAAAAAAAAAAAAAAAAAAAAAAAAAAAAAAAAAAAAAAAAAAAAAAAAA="
  }
};

bool decodeBase64ToBytes(const char* encoded, std::vector<uint8_t>& out) {
  size_t required = 0;
  int rc = mbedtls_base64_decode(
    nullptr, 0, &required,
    reinterpret_cast<const unsigned char*>(encoded),
    strlen(encoded)
  );
  if (rc != MBEDTLS_ERR_BASE64_BUFFER_TOO_SMALL && rc != 0) return false;
  if (required == 0) return false;

  out.assign(required, 0);
  size_t written = 0;
  rc = mbedtls_base64_decode(
    out.data(), out.size(), &written,
    reinterpret_cast<const unsigned char*>(encoded),
    strlen(encoded)
  );
  if (rc != 0) return false;
  if (written != out.size()) out.resize(written);
  return true;
}

void invertBitmapBytes(std::vector<uint8_t>& bytes) {
  for (uint8_t& b : bytes) b = ~b;
}

void drawTwoLines(const String& l1, const String& l2) {
  u8g2.clearBuffer();
  u8g2.setFont(u8g2_font_6x10_tf);
  u8g2.drawStr(0, 12, l1.c_str());
  u8g2.drawStr(0, 28, l2.c_str());
  u8g2.sendBuffer();
}

void clearOledFrame() {
  u8g2.clearBuffer();
  u8g2.sendBuffer();
  delay(OLED_CLEAR_SETTLE_MS);
}

int firstValidBlock() {
  int total = sizeof(kBlocks) / sizeof(kBlocks[0]);
  for (int i = 0; i < total; i++) {
    if (kBlocks[i].valid) return i;
  }
  return -1;
}

int nextValidBlock(int from) {
  int total = sizeof(kBlocks) / sizeof(kBlocks[0]);
  for (int i = from + 1; i < total; i++) {
    if (kBlocks[i].valid) return i;
  }
  return from;
}

int prevValidBlock(int from) {
  for (int i = from - 1; i >= 0; i--) {
    if (kBlocks[i].valid) return i;
  }
  return from;
}

int maxXFor(const Block& b) {
  return max(0, b.width - SCREEN_W);
}

void clampViewer() {
  if (currentBlock < 0 || !kBlocks[currentBlock].valid) currentBlock = firstValidBlock();
  if (currentBlock < 0) return;
  int maxX = maxXFor(kBlocks[currentBlock]);
  if (currentX < 0) currentX = 0;
  if (currentX > maxX) currentX = maxX;
}

void renderCurrentBlock() {
  clampViewer();
  if (currentBlock < 0) return;
  const Block& b = kBlocks[currentBlock];
  clearOledFrame();
  u8g2.clearBuffer();
  u8g2.setDrawColor(1);
  u8g2.drawXBMP(-currentX, 0, b.width, b.height, b.bytes.data());
  u8g2.sendBuffer();
  Serial.printf("[OLED] block %d x=%d maxX=%d\n", currentBlock + 1, currentX, maxXFor(b));
}

void moveUp() {
  int prev = prevValidBlock(currentBlock);
  if (prev != currentBlock) {
    currentBlock = prev;
    currentX = 0;
  }
}

void moveDown() {
  int next = nextValidBlock(currentBlock);
  if (next != currentBlock) {
    currentBlock = next;
    currentX = 0;
  }
}

void moveLeft() {
  if (currentX > 0) {
    currentX -= H_SCROLL_STEP;
    if (currentX < 0) currentX = 0;
    return;
  }

  int prev = prevValidBlock(currentBlock);
  if (prev != currentBlock) {
    currentBlock = prev;
    currentX = maxXFor(kBlocks[currentBlock]);
  }
}

void moveRight() {
  int maxX = maxXFor(kBlocks[currentBlock]);
  if (currentX < maxX) {
    currentX += H_SCROLL_STEP;
    if (currentX > maxX) currentX = maxX;
    return;
  }

  int next = nextValidBlock(currentBlock);
  if (next != currentBlock) {
    currentBlock = next;
    currentX = 0;
  }
}

void setup() {
  Serial.begin(115200);
  delay(700);
  Serial.println();
  Serial.println("=== OLED Bitmap Demo ===");

  btnUp.begin(BTN_SCROLL_UP);
  btnDown.begin(BTN_SCROLL_DOWN);
  btnLeft.begin(BTN_SCROLL_LEFT);
  btnRight.begin(BTN_SCROLL_RIGHT);

  Wire.begin(OLED_SDA, OLED_SCL);
  // 100 kHz is intentionally conservative for breadboard/flying-wire OLED tests.
  Wire.setClock(100000);
  u8g2.setI2CAddress(0x3C * 2);
  u8g2.begin();
  u8g2.setContrast(12);

  drawTwoLines("Bitmap demo", "Decoding...");

  int total = sizeof(kBlocks) / sizeof(kBlocks[0]);
  for (int i = 0; i < total; i++) {
    bool ok = decodeBase64ToBytes(kBlocks[i].b64, kBlocks[i].bytes);
    int expected = ((kBlocks[i].width + 7) / 8) * kBlocks[i].height;
    kBlocks[i].valid = ok && (int)kBlocks[i].bytes.size() == expected;
    if (!kBlocks[i].valid) {
      Serial.printf("[WARN] skip block %d size=%u expected=%d\n",
                    i + 1, (unsigned)kBlocks[i].bytes.size(), expected);
    } else {
      validCount++;
    }
  }

  drawTwoLines("Bitmap demo", "Rendering...");
  delay(600);

  if (validCount == 0) {
    drawTwoLines("No valid block", "check base64");
    Serial.println("[ERR] no valid bitmap blocks");
    return;
  }

  currentBlock = firstValidBlock();
  currentX = 0;
  renderCurrentBlock();
  Serial.printf("[OK] viewer ready, valid blocks=%d\n", validCount);
}

void loop() {
  bool changed = false;
  if (btnUp.fell()) {
    Serial.println("[BTN] UP");
    moveUp();
    changed = true;
  }
  if (btnDown.fell()) {
    Serial.println("[BTN] DOWN");
    moveDown();
    changed = true;
  }
  if (btnLeft.fell()) {
    Serial.println("[BTN] LEFT");
    moveLeft();
    changed = true;
  }
  if (btnRight.fell()) {
    Serial.println("[BTN] RIGHT");
    moveRight();
    changed = true;
  }
  if (changed) renderCurrentBlock();
  delay(20);
}
